## esp_idf_webserver/main/Kconfig.projbuild
```kconfig
menu "WiFi softAP config"

        config AP_WIFI_SSID
                string "WiFi SSID"
                default "ssid"
                help
                        SSID (network name) to connect to
        config AP_WIFI_PASSWORD
                string "WiFi Password"
                default "password"
                help
                        WiFi password (WPA or WPA2)

        config AP_WIFI_MAX_CONNECTED
                int "Max nº of stations connected"
                default 1
                help
                        Maximum number of devices allowed to connect to the AP
endmenu

menu "WiFi sta config"

        config STA_WIFI_SSID
                string "WiFi SSID"
                default "ssid"
                help
                        SSID (network name) to connect to

        config STA_WIFI_IDENTITY
                string "Identity"
                default "anonymous"
                help
                        anonymous@...

        config STA_WIFI_USERNAME
                string "Username"
                default "username"
                help 
                        ...@...

        config STA_WIFI_PASSWORD
                string "WiFi Password"
                default "password"
                help
                        WiFi password (WPA or WPA2)

        config STA_WIFI_RETRY_INTERVAL_MS
                int "WiFi reconnect interval between attempts"
                default 3000
                help
                        Set time interval between consecutive reconnection attampts
endmenu
```
